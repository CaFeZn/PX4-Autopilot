## src/drivers/heater1/Kconfig
```kconfig
menuconfig DRIVERS_HEATER1
	bool "heater1"
	default n
	---help---
		Enable support for heater
```

## src/drivers/heater2/Kconfig
```kconfig
menuconfig DRIVERS_HEATER2
	bool "heater2"
	default n
	---help---
		Enable support for heater
```

## src/drivers/heater_multi/Kconfig
```kconfig
menuconfig DRIVERS_HEATER_MULTI
	bool "heater_multi"
	default n
	---help---
		Enable support for heater_multi
```
